## boards/shields/scratchboard/Kconfig.defconfig
```kconfig
if SHIELD_SCRATCHBOARD_LEFT

config ZMK_KEYBOARD_NAME
    default "scratchboard_test"

config ZMK_SPLIT_ROLE_CENTRAL
    default y

endif # SHIELD_SCRATCHBOARD_LEFT

if SHIELD_SCRATCHBOARD_LEFT || SHIELD_SCRATCHBOARD_RIGHT

config ZMK_SPLIT
    default y

endif # SHIELD_SCRATCHBOARD_LEFT || SHIELD_SCRATCHBOARD_RIGHT
```

## boards/shields/scratchboard/Kconfig.shield
```kconfig
config SHIELD_SCRATCHBOARD_LEFT
    def_bool $(shields_list_contains,scratchboard_left)

config SHIELD_SCRATCHBOARD_RIGHT
    def_bool $(shields_list_contains,scratchboard_right)
```

## boards/shields/scratchpad/Kconfig.defconfig
```kconfig
if SHIELD_SCRATCHBOARD_LEFT

# Name must be less than 16 characters long!
config ZMK_KEYBOARD_NAME
    default "Scratchboard"

config ZMK_SPLIT_ROLE_CENTRAL
    default y

endif

if SHIELD_SCRATCHBOARD_LEFT || SHIELD_SCRATCHBOARD_RIGHT

config ZMK_SPLIT
    default y

endif
```

## boards/shields/scratchpad/Kconfig.shield
```kconfig
# No whitespace after the comma or in your part name!
config SHIELD_SCRATCHBOARD_LEFT
    def_bool $(shields_list_contains,scratchboard_left)

# No whitespace after the comma or in your part name!
config SHIELD_SCRATCHBOARD_RIGHT
    def_bool $(shields_list_contains,scratchboard_right)
```
